## Kconfig
```
menuconfig LED_SUBSYSTEM
    bool "LED Subsystem"
    default y
    help
      Master switch for the LED control logic.

if LED_SUBSYSTEM

    choice
        prompt "Blink interval"
        default BLINK_SLEEP_1000
        help
          Select the delay between LED state changes.

        config BLINK_SLEEP_250
            bool "250ms (Fast)"
        config BLINK_SLEEP_500
            bool "500ms (Normal)"
        config BLINK_SLEEP_1000
            bool "1s (Slow)"
        config BLINK_SLEEP_2000
            bool "2s (Very Slow)"
        config BLINK_SLEEP_CUSTOM
            bool "Manual entry..."
    endchoice

    config BLINK_SLEEP_CUSTOM_VALUE
        int "Enter value (250-3000)"
        range 250 3000
        default 250
        depends on BLINK_SLEEP_CUSTOM 

    config BLINK_SLEEP_MS
        int
        default 250 if BLINK_SLEEP_250
        default 500 if BLINK_SLEEP_500       
        default 1000 if BLINK_SLEEP_1000
        default 2000 if BLINK_SLEEP_2000
        default BLINK_SLEEP_CUSTOM_VALUE if BLINK_SLEEP_CUSTOM
        help
            Actual sleep time in ms.

    menuconfig ADVANCED_LED_SETTINGS
        bool "Advanced LED settings"
        default n

    if ADVANCED_LED_SETTINGS

        config LED_BRIGHTNESS
            int "Brightness level (0-100)"
            range 0 100
            default 100


        config LED_FADE_DURATION_MS
            int "Fade transition time (ms)"
            range 0 5000
            default 500

        menu "Developer settings"
            visible if ADVANCED_LED_SETTINGS

            config LED_DEBUG
                bool "Enable LED logging"
                default y
                help
                  Enables debug output for the LED subsystem.

            config BLINK_PATTERN
                bool "Custom blink pattern"
                default n
                help
                  Not implemented...

        endmenu

    endif

endif # LED_SUBSYSTEM

menu "Zephyr Kernel and Subsystems"
    source "${ZEPHYR_BASE}/Kconfig.zephyr"
endmenu
```

## prj.conf
```kconfig
CONFIG_GPIO=y
CONFIG_LOG=y
CONFIG_PWM=y

CONFIG_DEBUG=y
CONFIG_DEBUG_OPTIMIZATIONS=y
CONFIG_NO_OPTIMIZATIONS=n
CONFIG_DEBUG_THREAD_INFO=y

CONFIG_LED_SUBSYSTEM=y
CONFIG_ADVANCED_LED_SETTINGS=y
```

## boards/esp32_devkitc.overlay
```dts
/ {
    leds {
        compatible = "gpio-leds";

        led0: led_0 {
            gpios = <&gpio0 2 GPIO_ACTIVE_HIGH>;
            label = "Onboard LED";
        };
    };

    aliases {
        led0 = &led0;
    };
};
```

## src/main.cpp
```c
#include <zephyr/kernel.h>
#include <zephyr/device.h>
#include <zephyr/drivers/gpio.h>
#include <zephyr/drivers/pwm.h>
#include <zephyr/logging/log.h>

static const struct pwm_dt_spec led_pwm = PWM_DT_SPEC_GET(DT_ALIAS(pwm_led0));

LOG_MODULE_REGISTER(main, LOG_LEVEL_INF);

/**
 * @brief Changes the LED brightness gradually (fade effect).
 * * @param target_brightness Final brightness level (0-100)
 * @param duration_ms Time taken to reach the target brightness
 */
void led_fade_to(uint32_t target_brightness, uint32_t duration_ms) {
    static uint32_t current_brightness = 0;
    uint32_t steps = 50; // Number of steps to smooth the transition
    uint32_t sleep_per_step = duration_ms / steps;
    uint32_t period = led_pwm.period;

    if (duration_ms == 0) {
        pwm_set_pulse_dt(&led_pwm, (target_brightness * period) / 100);
        current_brightness = target_brightness;
        return;
    }

    for (int i = 1; i <= steps; i++) {
        // Simple linear interpolation: initial_value + (difference * progress)
        int32_t step_brightness = current_brightness + 
            ((int32_t)(target_brightness - current_brightness) * i / (int32_t)steps);
        
        uint32_t pulse = (step_brightness * period) / 100;
        pwm_set_pulse_dt(&led_pwm, pulse);
        
        k_msleep(sleep_per_step);
    }
    current_brightness = target_brightness;
}

int main(void) {
    if (!pwm_is_ready_dt(&led_pwm)) {
        LOG_ERR("Error: PWM device not ready");
        return 0;
    }

    LOG_INF("LED Subsystem initialized. Fade: %d ms, Brightness: %d%%", 
            CONFIG_LED_FADE_DURATION_MS, CONFIG_LED_BRIGHTNESS);

    while (1) {
        // Fade UP effect
        if (CONFIG_LED_DEBUG) LOG_INF("LED Fade UP");
        led_fade_to(CONFIG_LED_BRIGHTNESS, CONFIG_LED_FADE_DURATION_MS);
        
        k_msleep(CONFIG_BLINK_SLEEP_MS);

        // Fade DOWN effect
        if (CONFIG_LED_DEBUG) LOG_INF("LED Fade DOWN");
        led_fade_to(0, CONFIG_LED_FADE_DURATION_MS);

        k_msleep(CONFIG_BLINK_SLEEP_MS);
    }
    return 0;
}
```
